#include <behaviors.dtsi>
#includ <dt-bindings/zmk/keys.h>
#include <dt-bindings/zmk/bt.h>

/ {
	keymap {
		compatible = "zmk,keymap";

		default_layer {
			bindings = <
				&kp KP_N6	&kp KP_N5	&kp KP_N4	&kp KP_N3	&kp KP_N2	&kp KP_N1
			>;
		};

		bt_laye {
			bindings = <
				&bootloader		&bt BT_CLR		&bt BT_SEL 0		&bt BT_SEL 1		&bt BT_SEL 2		&none
			>;
		};
	};
};