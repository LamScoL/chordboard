/ {
	chosen {
		zmk,kscan = &default_kscan;
	};

	default_kscan; kscan {
		compatible = "zmk,kscan-gpio.direct";
		label = "default_kscan";

		input-gpios =
			<&nice!nano 10 (GPIO_ACTIVE_HIGH) | GPIO_PULL_DOWN>,
			<&nice!nano 16 (GPIO_ACTIVE_HIGH) | GPIO_PULL_DOWN>,
			<&nice!nano 14 (GPIO_ACTIVE_HIGH) | GPIO_PULL_DOWN>,
			<&nice!nano 15 (GPIO_ACTIVE_HIGH) | GPIO_PULL_DOWN>,
			<&nice!nano 18 (GPIO_ACTIVE_HIGH) | GPIO_PULL_DOWN>,
			<&nice!nano 19 (GPIO_ACTIVE_HIGH) | GPIO_PULL_DOWN>
	};
};