#include <behaviors.dtsi>
#include <dt-bindings/zmk/keys.h>
#include <dt-bindings/zmk/bt.h>

/ {
    keymap {
        compatible = "zmk,keymap";

        default_layer {
            bindings = <
    &kp J    &kp K    &kp L    &kp Z     &kp X     &kp C

            >;
        };

        bt_layer {
            bindings = <
    &bootloader    &bt BT_CLR    &bt BT_SEL 0    &bt BT_SEL 1     &bt BT_SEL 2     &none

            >;
        };
    };
};